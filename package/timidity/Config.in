## package/timidity/Config.in
```kconfig
config BR2_PACKAGE_TIMIDITY
	bool "timidity"
	select BR2_PACKAGE_ALSA_LIB_RAWMINI
	select BR2_PACKAGE_ALSA_LIB_SEQ
	select BR2_PACKAGE_ALSA_LIB_HWDEP
	depends on BR2_PACKAGE_ALSA_LIB
	help
	  TiMidity++ is an open source MIDI to WAVE converter and player.
```
